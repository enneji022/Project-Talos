#include <Arduino.h>

// Ultrasonic Sensor Pins (FL, ML, C, MR, FR)
const uint8_t TRIG_PINS[5] = {22, 17, 5, 19, 25};
const uint8_t ECHO_PINS[5] = {23, 16, 18, 21, 26};

// Inter-ESP UART Output Pins
#define TX2_PIN 32
#define RX2_PIN 27

// Reduced timeout to 15ms (~2.5m) to prevent simulation lag on missed echoes
const unsigned long TIMEOUT_US = 15000; 

struct SensorPayload {
    uint16_t dist_cm[5]; // Distances in cm
    uint8_t checksum;
};

uint8_t calculateChecksum(const SensorPayload& payload) {
    uint8_t sum = 0;
    const uint8_t* ptr = (const uint8_t*)&payload;
    for (size_t i = 0; i < sizeof(SensorPayload) - 1; i++) {
        sum ^= ptr[i];
    }
    return sum;
}

float readDistanceCM(uint8_t trigPin, uint8_t echoPin) {
    // 1. Generate Trigger Pulse
    digitalWrite(trigPin, LOW);
    delayMicroseconds(2);
    digitalWrite(trigPin, HIGH);
    delayMicroseconds(10);
    digitalWrite(trigPin, LOW);

    // 2. Measure pulse duration generated by SimulIDE distance slider
    unsigned long duration = pulseIn(echoPin, HIGH, TIMEOUT_US);
    
    if (duration == 0) return -1.0f; // Timeout or out of range
    return (duration * 0.0343f) / 2.0f;
}

void setup() {
    Serial.begin(115200);                                // Debug USB Serial
    Serial2.begin(115200, SERIAL_8N1, RX2_PIN, TX2_PIN); // Output UART to Motor ESP

    for (int i = 0; i < 5; i++) {
        pinMode(TRIG_PINS[i], OUTPUT);
        pinMode(ECHO_PINS[i], INPUT);
        digitalWrite(TRIG_PINS[i], LOW);
    }

    delay(500);
    Serial.println("--- 5x Ultrasonic SimulIDE Test Initialized ---");
}

void loop() {
    SensorPayload payload;

    // Read all 5 HC-SR04 sliders
    for (int i = 0; i < 5; i++) {
        float dist = readDistanceCM(TRIG_PINS[i], ECHO_PINS[i]);
        payload.dist_cm[i] = (dist < 0) ? 999 : (uint16_t)dist;
        delay(2); // Short gap between readings for simulator stability
    }

    // Compute XOR checksum and send via Hardware Serial2
    payload.checksum = calculateChecksum(payload);
    Serial2.write((uint8_t*)&payload, sizeof(SensorPayload));

    // Print values to Serial Monitor / Plotter
    Serial.print("FL:"); Serial.print(payload.dist_cm[0]);
    Serial.print(" ML:"); Serial.print(payload.dist_cm[1]);
    Serial.print(" C:"); Serial.print(payload.dist_cm[2]);
    Serial.print(" MR:"); Serial.print(payload.dist_cm[3]);
    Serial.print(" FR:"); Serial.println(payload.dist_cm[4]);

    delay(50); // ~20 Hz update rate
}